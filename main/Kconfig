## main/Kconfig
```kconfig
menu "Espressif USB OTBR"
    menu "USB netif ip info configuration"
        config USB_NETIF_IP
            string "USB netif IP"
            default "192.168.168.249"
            help
                USB netif ip info configuration IP.
        config USB_NETIF_GATEWAY
            string "USB netif gateway"
            default "192.168.168.252"
            help
                USB netif ip info configuration gateway.
        config USB_NETIF_NETMASK
            string "USB netif netmask"
            default "255.255.255.0"
            help
                USB netif ip info configuration netmask.
    endmenu
endmenu 
```

## sdkconfig.defaults.ref
```kconfig
CONFIG_ESPTOOLPY_FLASHSIZE_8MB=y
CONFIG_ESPTOOLPY_FLASHSIZE="8MB"
CONFIG_PARTITION_TABLE_CUSTOM=y
CONFIG_PARTITION_TABLE_CUSTOM_FILENAME="partitions.csv"
CONFIG_COMPILER_OPTIMIZATION_SIZE=y
CONFIG_ESP_CONSOLE_SECONDARY_NONE=y
CONFIG_ESP_CONSOLE_USB_SERIAL_JTAG_ENABLED=n
CONFIG_LWIP_NETIF_STATUS_CALLBACK=y
CONFIG_LWIP_IPV6_NUM_ADDRESSES=12
CONFIG_LWIP_IPV6_RDNSS_MAX_DNS_SERVERS=2
CONFIG_LWIP_IPV6_ND6_ROUTE_INFO_OPTION_SUPPORT=y
CONFIG_VFS_SELECT_IN_RAM=y
CONFIG_TINYUSB_NET_MODE_NCM=y
CONFIG_ESP_SYSTEM_EVENT_TASK_STACK_SIZE=3584
CONFIG_ESP_MAIN_TASK_STACK_SIZE=5120
CONFIG_MBEDTLS_SSL_PROTO_DTLS=y
CONFIG_MBEDTLS_ECJPAKE_C=y
CONFIG_MBEDTLS_KEY_EXCHANGE_ECJPAKE=y

CONFIG_OPENTHREAD_IPERF_CMD_ENABLE=n
CONFIG_OPENTHREAD_ENABLED=y
CONFIG_OPENTHREAD_TASK_NAME="ot_main"
CONFIG_OPENTHREAD_TASK_SIZE=8192
CONFIG_OPENTHREAD_TASK_PRIORITY=5
CONFIG_OPENTHREAD_PACKAGE_NAME="openthread-esp32"
CONFIG_OPENTHREAD_PLATFORM_INFO="esp32s3"
CONFIG_OPENTHREAD_CONSOLE_ENABLE=y
CONFIG_OPENTHREAD_CONSOLE_TYPE_UART=y
CONFIG_OPENTHREAD_CLI=y
CONFIG_OPENTHREAD_CONSOLE_COMMAND_PREFIX="ot"
CONFIG_OPENTHREAD_NETWORK_NAME="OpenThread-ESP"
CONFIG_OPENTHREAD_MESH_LOCAL_PREFIX="fd00:db8:a0:0::/64"
CONFIG_OPENTHREAD_NETWORK_CHANNEL=15
CONFIG_OPENTHREAD_NETWORK_PANID=0x1234
CONFIG_OPENTHREAD_NETWORK_EXTPANID="dead00beef00cafe"
CONFIG_OPENTHREAD_NETWORK_MASTERKEY="00112233445566778899aabbccddeeff"
CONFIG_OPENTHREAD_NETWORK_PSKC="104810e2315100afd6bc9215a6bfac53"
CONFIG_OPENTHREAD_FTD=y
CONFIG_OPENTHREAD_RADIO_SPINEL_UART=y
CONFIG_OPENTHREAD_BORDER_ROUTER=y
CONFIG_OPENTHREAD_COMMISSIONER=y
CONFIG_OPENTHREAD_COMM_MAX_JOINER_ENTRIES=2
CONFIG_OPENTHREAD_JOINER=y
CONFIG_OPENTHREAD_SRP_CLIENT=y
CONFIG_OPENTHREAD_SRP_CLIENT_MAX_SERVICES=5
CONFIG_OPENTHREAD_DNS_CLIENT=y
CONFIG_OPENTHREAD_DNS64_CLIENT=y
CONFIG_OPENTHREAD_DNS_SERVER_ADDR="8.8.8.8"
CONFIG_OPENTHREAD_BORDER_AGENT_ENABLE=y
CONFIG_OPENTHREAD_CSL_ACCURACY=50
CONFIG_OPENTHREAD_CSL_UNCERTAIN=50
CONFIG_OPENTHREAD_RX_ON_WHEN_IDLE=y
CONFIG_OPENTHREAD_DIAG=y
CONFIG_OPENTHREAD_PARENT_SEARCH_CHECK_INTERVAL_MINS=9
CONFIG_OPENTHREAD_PARENT_SEARCH_BACKOFF_INTERVAL_MINS=600
CONFIG_OPENTHREAD_PARENT_SEARCH_RSS_THRESHOLD=-65
CONFIG_OPENTHREAD_PARENT_SEARCH_RESELECT_TIMEOUT_MINS=90
CONFIG_OPENTHREAD_PARENT_SEARCH_RSS_MARGIN=7
CONFIG_OPENTHREAD_ADDRESS_QUERY_TIMEOUT=3
CONFIG_OPENTHREAD_ADDRESS_QUERY_RETRY_DELAY=15
CONFIG_OPENTHREAD_ADDRESS_QUERY_MAX_RETRY_DELAY=120
CONFIG_OPENTHREAD_PREFERRED_CHANNEL_MASK=0x7fff800
CONFIG_OPENTHREAD_SUPPORTED_CHANNEL_MASK=0x7fff800
CONFIG_OPENTHREAD_NUM_MESSAGE_BUFFERS=65
CONFIG_OPENTHREAD_XTAL_ACCURACY=10
CONFIG_OPENTHREAD_BUS_LATENCY=4000
CONFIG_OPENTHREAD_MLE_MAX_CHILDREN=10
CONFIG_OPENTHREAD_TMF_ADDR_CACHE_ENTRIES=20
CONFIG_OPENTHREAD_UART_BUFFER_SIZE=2048
CONFIG_OPENTHREAD_MAC_MAX_CSMA_BACKOFFS_DIRECT=4
CONFIG_OPENTHREAD_LOG_LEVEL_DYNAMIC=y
CONFIG_OPENTHREAD_SPINEL_RX_FRAME_BUFFER_SIZE=2048
CONFIG_OPENTHREAD_DEBUG=y
CONFIG_OPENTHREAD_CLI_ESP_EXTENSION=y
```
